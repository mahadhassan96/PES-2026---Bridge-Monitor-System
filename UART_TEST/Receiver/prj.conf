## CMakeLists.txt
```
# See anatomy of a CMake file here: https://docs.zephyrproject.org/latest/develop/application/index.html#creating-an-application-by-hand
cmake_minimum_required(VERSION 3.13.1)

# Sets the variable BOARD, which tells build system which board to select if no board is specified
set(BOARD rpi_pico2/rp2350a/m33)

# Pulls in Zephyr build system
find_package(Zephyr)

# Defines application
project(Receiver)

# Collects and adds sources to app target
file(GLOB SRC_FILES "src/*c")
target_sources(app PRIVATE ${SRC_FILES})
```

## prj.conf
```kconfig
CONFIG_SERIAL=y
CONFIG_CONSOLE=y
CONFIG_UART_CONSOLE=y
CONFIG_STDOUT_CONSOLE=y
CONFIG_UART_LINE_CTRL=y

CONFIG_USB_DEVICE_STACK_NEXT=y
CONFIG_CDC_ACM_SERIAL_INITIALIZE_AT_BOOT=y
CONFIG_CDC_ACM_SERIAL_PID=0x0004
CONFIG_CDC_ACM_SERIAL_PRODUCT_STRING="USBD console sample"

CONFIG_UART_INTERRUPT_DRIVEN=y
```

## src/main.c
```c
#include <zephyr/kernel.h>
#include <zephyr/drivers/uart.h>
#include <zephyr/sys/printk.h>

#define UART_NODE DT_NODELABEL(uart0)

static const struct device *uart_dev = DEVICE_DT_GET(UART_NODE);

int main(void)
{
    unsigned char recv_char;

    if (!device_is_ready(uart_dev)) {
        printk("UART device not ready\n");
        return -1;
    }

    printk("Receiver ready on UART0 (GP0/GP1). Waiting for data...\n");

    while (1) {
        if (uart_poll_in(uart_dev, &recv_char) == 0) {
            printk("%c", recv_char);
        }
        // Small sleep to prevent watchdog issues in tight loops
        k_yield();
    }
}
```
