## Base_station/build/Kconfig/arch/Kconfig.tmp
```kconfig
# Load Zephyr Arch Kconfig descriptions.
osource "/Users/joshdean/zephyrproject/zephyr/arch/rx/Kconfig"
osource "/Users/joshdean/zephyrproject/zephyr/arch/x86/Kconfig"
osource "/Users/joshdean/zephyrproject/zephyr/arch/xtensa/Kconfig"
osource "/Users/joshdean/zephyrproject/zephyr/arch/sparc/Kconfig"
osource "/Users/joshdean/zephyrproject/zephyr/arch/riscv/Kconfig"
osource "/Users/joshdean/zephyrproject/zephyr/arch/posix/Kconfig"
osource "/Users/joshdean/zephyrproject/zephyr/arch/mips/Kconfig"
osource "/Users/joshdean/zephyrproject/zephyr/arch/arm64/Kconfig"
osource "/Users/joshdean/zephyrproject/zephyr/arch/arm/Kconfig"
osource "/Users/joshdean/zephyrproject/zephyr/arch/arc/Kconfig"
```

## Base_station/build/Kconfig/boards/Kconfig.defconfig.tmp
```kconfig
# Load Zephyr board defconfig descriptions.
osource "/Users/joshdean/zephyrproject/zephyr/boards/raspberrypi/rpi_pico2/Kconfig.defconfig"
```

## Base_station/build/Kconfig/boards/Kconfig.rpi_pico2.tmp
```kconfig
# Load board Kconfig descriptions.
osource "/Users/joshdean/zephyrproject/zephyr/boards/raspberrypi/rpi_pico2/Kconfig.rpi_pico2"
```

## Base_station/build/Kconfig/boards/Kconfig.sysbuild
```kconfig
# Load Sysbuild board Kconfig descriptions.
osource "/Users/joshdean/zephyrproject/zephyr/boards/raspberrypi/rpi_pico2/Kconfig.sysbuild"
```

## Base_station/build/Kconfig/boards/Kconfig.tmp
```kconfig
# Load Zephyr board Kconfig descriptions.
osource "/Users/joshdean/zephyrproject/zephyr/boards/raspberrypi/rpi_pico2/Kconfig"
```

## UART_TEST/Receiver/build/Kconfig/arch/Kconfig
```kconfig
# Load Zephyr Arch Kconfig descriptions.
osource "/home/amine/zephyrproject/zephyr/arch/rx/Kconfig"
osource "/home/amine/zephyrproject/zephyr/arch/x86/Kconfig"
osource "/home/amine/zephyrproject/zephyr/arch/xtensa/Kconfig"
osource "/home/amine/zephyrproject/zephyr/arch/sparc/Kconfig"
osource "/home/amine/zephyrproject/zephyr/arch/riscv/Kconfig"
osource "/home/amine/zephyrproject/zephyr/arch/posix/Kconfig"
osource "/home/amine/zephyrproject/zephyr/arch/mips/Kconfig"
osource "/home/amine/zephyrproject/zephyr/arch/arm64/Kconfig"
osource "/home/amine/zephyrproject/zephyr/arch/arm/Kconfig"
osource "/home/amine/zephyrproject/zephyr/arch/arc/Kconfig"
```

## UART_TEST/Sender/build/Kconfig/boards/Kconfig.rpi_pico2.tmp
```kconfig
# Load board Kconfig descriptions.
osource "/home/amine/zephyrproject/zephyr/boards/raspberrypi/rpi_pico2/Kconfig.rpi_pico2"
```

## UART_TEST/Sender/build/Kconfig/boards/Kconfig.tmp
```kconfig
# Load Zephyr board Kconfig descriptions.
osource "/home/amine/zephyrproject/zephyr/boards/raspberrypi/rpi_pico2/Kconfig"
```

## sensor_node/drivers/fsr_4xx/Kconfig
```kconfig
config FSR_4XX
	bool "FSR 4XX Force Sensitive Resistor"
	default y
	depends on DT_HAS_FSR_4XX_ENABLED
	select ADC
	help
	  Enable the driver for the FSR 4XX.
```
