## Base_station/drivers/sensor_node/Kconfig
```kconfig
config SENSOR_NODE
  bool "Custom SENSOR_NODE driver"
  default y
  depends on UART
  depends on DT_HAS_SENSOR_NODE_ENABLED
  help
    Enable support for the custom SENSOR_NODE distance sensor driver.
```

## base_station/drivers/sensor_node/Kconfig
```kconfig
config SENSOR_NODE
  bool "Custom SENSOR_NODE driver"
  default y
  depends on UART
  help
    Enable support for the custom SENSOR_NODE driver.
```

## sensor_node/drivers/adxl_313/Kconfig
```kconfig
config ADXL_313
	bool "ADXL 313 3-Axis Accelerometer"
	default y
	depends on DT_HAS_ADXL_313_ENABLED
	select I2C
	help
	  Enable the driver for the ADXL_313.
```

## sensor_node/drivers/vl53l1x/Kconfig
```kconfig
config VL53L1X_ST
  bool "Custom VL53L1X time-of-flight sensor driver"
  default y
  depends on I2C
  depends on GPIO
  depends on DT_HAS_VL53L1X_ST_ENABLED
  help
    Enable support for the custom VL53L1X distance sensor driver.
```

## testing/base_station/testcase.yaml
```yaml
tests:
  base_station.unit:
    platform_allow:
      - rpi_pico2/rp2350a/m33
    harness: ztest
```
